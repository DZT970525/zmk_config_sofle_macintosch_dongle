## config/boards/arm/sofle_dongle/Kconfig
```kconfig
# Copyright (c) 2025 ZitaoTech
# SPDX-License-Identifier: MIT

config BOARD_SOFLE_DONGLE
    bool

config BOARD_SOFLE_DONGLE_LEFT
    bool

config BOARD_SOFLE_DONGLE_RIGHT
    bool
```

## config/boards/arm/sofle_dongle/Kconfig.board
```kconfig
# Copyright (c) 2025 ZitaoTech
# SPDX-License-Identifier: MIT

config BOARD_SOFLE_DONGLE
    bool "sofle dongle"
    depends on SOC_NRF52840_QIAA

config BOARD_SOFLE_DONGLE_LEFT
    bool "sofle dongle left"
    depends on SOC_NRF52840_QIAA

config BOARD_SOFLE_DONGLE_RIGHT
    bool "sofle dongle right"
    depends on SOC_NRF52840_QIAA

menu "A320 Trackpad Setting"

config A320_TRACKPAD_SCROLL_INTERVAL
    int "Trackpad scroll in miliseconds"
    default 50
    range 0 200
    help
      The bigger this value, the slower the trackpad scrolls

config A320_LOG_LEVEL
	int "Log Level for Touch"
	default 4

config A320
	bool "A320 Driver"
	depends on I2C && GPIO
	help
	  Projected capacitive trackpad/touchscreen controller.

config INPUT_A320_INIT_PRIORITY
  int "A320 Initialization Priority"
  default 90

endmenu
```

## config/boards/arm/sofle_dongle/Kconfig.defconfig
```kconfig
#
# Copyright (c) 2025 ZitaoTech
# SPDX-License-Identifier: MIT
#

if BOARD_SOFLE_DONGLE

config ZMK_KEYBOARD_NAME
    default "SOFLE_DONGLE"

config ZMK_SPLIT_ROLE_CENTRAL
    default y

endif # BOARD_SOFLE_DONGLE


if BOARD_SOFLE_DONGLE || BOARD_SOFLE_DONGLE_LEFT || BOARD_SOFLE_DONGLE_RIGHT

if ZMK_BACKLIGHT

config PWM
    default y

config LED_PWM
    default y

endif # ZMK_BACKLIGHT

config BOARD
    default "SOFLE_DONGLE"

config ZMK_SPLIT
    default y

config ZMK_SPLIT_PERIPHERAL_HID_INDICATORS
    default y

config BT_CTLR
    default BT

endif # BOARD_SOFLE_DONGLE || BOARD_SOFLE_DONGLE_LEFT || BOARD_SOFLE_DONGLE_RIGHT
```

## config/boards/arm/sofle_dongle/sofle_dongle_defconfig
```kconfig
# Copyright (c) 2025 ZitaoTech
# SPDX-License-Identifier: MIT

CONFIG_SOC_SERIES_NRF52X=y
CONFIG_SOC_NRF52840_QIAA=y
CONFIG_BOARD_SOFLE_DONGLE=y


# Enable MPU
CONFIG_ARM_MPU=y

CONFIG_PINCTRL=y

# enable GPIO
CONFIG_GPIO=y

# Build Configuration
CONFIG_USE_DT_CODE_PARTITION=y
CONFIG_BUILD_OUTPUT_UF2=y

# Flash configuration
CONFIG_MPU_ALLOW_FLASH_WRITE=y
CONFIG_NVS=y
CONFIG_SETTINGS_NVS=y
CONFIG_FLASH=y
CONFIG_FLASH_PAGE_LAYOUT=y
CONFIG_FLASH_MAP=y

# Enable Signal Power Plus
CONFIG_BT_CTLR_TX_PWR_PLUS_8=y

# Sleep Setting
CONFIG_ZMK_SLEEP=n
CONFIG_ZMK_EXT_POWER=y
# timeout for backlight for keyboard in miliseconds
CONFIG_ZMK_IDLE_TIMEOUT=600000                         


# 5 profiles (n+2)
CONFIG_BT_MAX_CONN=7
CONFIG_BT_MAX_PAIRED=7

# Keyboard backlight Setting
# enable keyboard backlight
CONFIG_ZMK_BACKLIGHT=y                           
# set the brightness the keyboard backlight when powered on in 1-100
CONFIG_ZMK_BACKLIGHT_BRT_START=40                     
# set the brightness step for each change of backlight brightness
CONFIG_ZMK_BACKLIGHT_BRT_STEP=10                      
# enable keyboard backlight on when powered on
CONFIG_ZMK_BACKLIGHT_ON_START=y                       
# enable automatic turn off when no keypress detected
CONFIG_ZMK_BACKLIGHT_AUTO_OFF_IDLE=y                  

# HID indicator configuration
CONFIG_ZMK_HID_INDICATORS=y

                
# Enable Mouse
CONFIG_ZMK_POINTING=y
CONFIG_INPUT=y
CONFIG_ZMK_MOUSE=y
CONFIG_ZMK_POINTING=y

# Debuncing Setting 
CONFIG_ZMK_KSCAN_DEBOUNCE_PRESS_MS=10
CONFIG_ZMK_KSCAN_DEBOUNCE_RELEASE_MS=10

# Enable both USB and BLE
CONFIG_ZMK_USB=y
CONFIG_ZMK_BLE=y

# Milliseconds to wait after a setting change before writing it to flash memory
CONFIG_ZMK_SETTINGS_SAVE_DEBOUNCE=1000

# Enable EC11 Setting
CONFIG_EC11=y
CONFIG_EC11_TRIGGER_GLOBAL_THREAD=y

# ZMK Studio
CONFIG_ZMK_STUDIO=y
CONFIG_ZMK_STUDIO_LOCKING=n
CONFIG_ZMK_STUDIO_LOCK_ON_DISCONNECT=n

# Log via USB or Segger RTT
CONFIG_ZMK_USB_LOGGING=n
CONFIG_LOG_PROCESS_THREAD_STARTUP_DELAY_MS=4000
```

## config/boards/arm/sofle_dongle/sofle_dongle_numpad_defconfig
```kconfig
# Copyright (c) 2025 ZitaoTech
# SPDX-License-Identifier: MIT

CONFIG_SOC_SERIES_NRF52X=y
CONFIG_SOC_NRF52840_QIAA=y
CONFIG_BOARD_SOFLE_DONGLE_LEFT=y


# Enable MPU
CONFIG_ARM_MPU=y

# enable GPIO
CONFIG_GPIO=y
CONFIG_PINCTRL=y
# Build Configuration
CONFIG_USE_DT_CODE_PARTITION=y
CONFIG_BUILD_OUTPUT_UF2=y

# Flash configuration
CONFIG_MPU_ALLOW_FLASH_WRITE=y
CONFIG_NVS=y
CONFIG_SETTINGS_NVS=y
CONFIG_FLASH=y
CONFIG_FLASH_PAGE_LAYOUT=y
CONFIG_FLASH_MAP=y

# Enable Signal Power Plus
CONFIG_BT_CTLR_TX_PWR_PLUS_8=y


# Sleep Setting
CONFIG_ZMK_SLEEP=y
CONFIG_ZMK_IDLE_SLEEP_TIMEOUT=1800000
CONFIG_ZMK_EXT_POWER=y
CONFIG_ZMK_IDLE_TIMEOUT=30000                         

# enable automatic turn off when no keypress detected


# HID indicator configuration
CONFIG_ZMK_HID_INDICATORS=y

# Debuncing Setting 
CONFIG_ZMK_KSCAN_DEBOUNCE_PRESS_MS=10
CONFIG_ZMK_KSCAN_DEBOUNCE_RELEASE_MS=10

# Enable both USB and BLE
CONFIG_ZMK_USB=y
CONFIG_ZMK_BLE=y

# Milliseconds to wait after a setting change before writing it to flash memory
CONFIG_ZMK_SETTINGS_SAVE_DEBOUNCE=1000

# ZMK Studio
CONFIG_ZMK_STUDIO=y
CONFIG_ZMK_STUDIO_LOCKING=n
CONFIG_ZMK_STUDIO_LOCK_ON_DISCONNECT=n

# Log via USB or Segger RTT
CONFIG_ZMK_USB_LOGGING=n
CONFIG_LOG_PROCESS_THREAD_STARTUP_DELAY_MS=4000


# Enable Mouse
CONFIG_INPUT=y
CONFIG_INPUT_THREAD_STACK_SIZE=2048

# Numpad specific - no backlight/mouse/trackball needed
# CONFIG_ZMK_BACKLIGHT is not set
# CONFIG_ZMK_RGB_UNDERGLOW is not set
# CONFIG_ZMK_MOUSE is not set
# CONFIG_ZMK_POINTING is not set
# CONFIG_EC11 is not set
```

## config/boards/shields/left_bbtrackball_dongle/Kconfig.shield
```kconfig
# Copyright (c) 2022 The ZMK Contributors
# SPDX-License-Identifier: MIT

config SHIELD_LEFT_BBTRACKBALL_DONGLE
    def_bool $(shields_list_contains,left_bbtrackball_dongle)

menu "BBtrackball Setting"


config BBtrackball_lighted_when_moved
	bool "BBtrackball led lighted when moved"

config BBtrackball_max_brightness
    int "BBtrackball brightness when moved"
    default 20
    range 0 100
    help
      The brightness when you move the BB trackball
      
endmenu
```

## config/boards/shields/lpm_view/Kconfig.shield
```kconfig
# Copyright (c) 2022 The ZMK Contributors
# SPDX-License-Identifier: MIT

config SHIELD_LPM_VIEW
    def_bool $(shields_list_contains,lpm_view)

menuconfig LPM009M360A
		bool "LPM009M360A display driver"
		default n
		select SPI
		help 
		 Enable driver for LPM009M360A display
```

## config/boards/shields/right_trackpoint_dongle/Kconfig.shield
```kconfig
# Copyright (c) 2022 The ZMK Contributors
# SPDX-License-Identifier: MIT

config SHIELD_RIGHT_TRACKPOINT_DONGLE
    def_bool $(shields_list_contains,right_trackpoint_dongle)

menu "TrackPoint Advanced Settings"

config TRACKPOINT_EXPONENTIAL
    bool "Enable TrackPoint exponential acceleration"
    default y
    help
      Enable exponential acceleration for TrackPoint movement,

config TRACKPOINT_SCROLL_X_DIR
    int "Scroll X direction multiplier (1 for normal, -1 for inverted)"
    default 1

config TRACKPOINT_SCROLL_Y_DIR
    int "Scroll Y direction multiplier (1 for normal, -1 for inverted)"
    default 1

config TRACKPOINT_SCROLL_DEADZONE
    int "Scroll deadzone"
    default 2
    help
      Deadzone to filter out slight hand tremors.

config TRACKPOINT_SCROLL_INPUT_MAX
    int "Scroll input max"
    default 128

config TRACKPOINT_SCROLL_DIVISOR_SLOW
    int "Scroll divisor slow (Fine-grained control)"
    default 60

config TRACKPOINT_SCROLL_DIVISOR_FAST
    int "Scroll divisor fast (Max speed limit)"
    default 8

config TRACKPOINT_DOMINANT_NUMERATOR
    int "Dominant axis numerator for accidental touch prevention"
    default 3

config TRACKPOINT_DOMINANT_DENOMINATOR
    int "Dominant axis denominator for accidental touch prevention"
    default 2

config TRACKPOINT_MOUSE_BASE_SPEED_PERCENT
    int "Mouse base speed (Percentage, 50 = 0.5)"
    default 50

config TRACKPOINT_MOUSE_SENS_BASE_PERCENT
    int "Mouse sensitivity base (Percentage, 30 = 0.3)"
    default 30

config TRACKPOINT_MOUSE_SENS_STEP_PERCENT
    int "Mouse sensitivity step per LED brightness (Percentage, 1 = 0.01)"
    default 1


endmenu
```

## config/boards/shields/st7789_display/Kconfig.defconfig
```kconfig
if SHIELD_ST7789_DISPLAY

config ZMK_SPLIT_BLE_CENTRAL_BATTERY_LEVEL_FETCHING
    default y

config ZMK_DISPLAY
   default y
   

config ZMK_DISPLAY_STATUS_SCREEN_CUSTOM
    select LV_USE_LABEL
    select LV_USE_BAR
    select LV_USE_FLEX
    select LV_USE_ROLLER
    select LV_COLOR_SCREEN_TRANSP
    select ZMK_WPM
    
config ZMK_SPLIT_ROLE_CENTRAL
    default y

choice ZMK_DISPLAY_STATUS_SCREEN
    default ZMK_DISPLAY_STATUS_SCREEN_CUSTOM
endchoice

config ZMK_DISPLAY_STATUS_SCREEN_CUSTOM
    select ZMK_WPM
    imply ZMK_HID_INDICATORS

choice ZMK_DISPLAY_WORK_QUEUE
    default ZMK_DISPLAY_WORK_QUEUE_DEDICATED
endchoice

config LV_Z_VDB_SIZE
	default 64
    
config LV_DPI_DEF
    default 148

config LV_Z_BITS_PER_PIXEL
    default 16

choice ST7789V_PIXEL_FORMAT
    default ST7789V_RGB565
endchoice

choice LV_COLOR_DEPTH
    default LV_COLOR_DEPTH_16
endchoice

config LV_COLOR_16_SWAP
	default n

config LV_DISP_DEF_REFR_PERIOD
    default 20

choice LV_FONT_DEFAULT
    default LV_FONT_DEFAULT_MONTSERRAT_20
endchoice

config PWM
    default y

config LED_PWM
    default y
    
endif

if SHIELD_ST7789_DISPLAY 

config ZMK_SPLIT
    default y

config DEFAULT_SCREEN
    string "Default screen"
    default "snake"

config SHOW_SINGLE_BATTERY
    bool "Show single battery"
    default n

config USE_BATTERY_FONT_3X5
    bool "Use battery font 3x5"
    default n

config DISPLAY_BRIGHTNESS
    int "Display brightness"
    default 100

config MUTE_THRESHOLD
    int "Mute threshold"
    default 600

config THEME_THRESHOLD
    int "Theme threshold"
    default 300

config THEME_PRIMARY_COLOR
    string "Theme primary color"
    default "3dff98"

config THEME_SECONDARY_COLOR
    string "Theme secondary color"
    default "ff4adc"

config THEME_BG_COLOR
    string "Theme background color"
    default "222323"
    
config THEME_BG_DARKER_COLOR
    string "Theme background darker color"
    default "121313"

config SNAKE_FATNESS
    int "Snake fatness"
    default 2

config SPLASH_USE_SNAKE_2
    bool "Use Snake 2 Splash screen"
    default n

config USE_SPLASH_SOUND
    bool "Use splash sound"
    default n

config USE_FOOD_SOUND
    bool "Use food sound"
    default n

config USE_DIE_SOUND
    bool "Use food sound"
    default n

config USE_STATUS_SOUND
    bool "Use status sound"
    default y

config USE_THEME_SOUND
    bool "Use theme sound"
    default n

config USE_MENU_SOUND
    bool "Use menu sound"
    default n

config USE_BUZZER
    bool "Use buzzer"
    default n

config INFO_LEFT_SLOT
    string "Info left slot"
    default "connectivity"

config INFO_RIGHT_SLOT
    string "Info right slot"
    default "layer"

config SNAKE_BOARD_SIZE
    string "Snake board size"
    default "XL"

config SNAKE_WALK_INTERVAL
    int "Snake walk interval"
    default 10

config LOGO_WALK_INTERVAL
    int "Logo walk interval"
    default 50

config CHECKERED_BOARD
    bool "Checkered board"
    default y

config WPM_SLOW
    int "WPM slow"
    default 20

config WPM_MEDIUM
    int "WPM medium"
    default 40

config WPM_FAST
    int "WPM fast"
    default 80

config WPM_SUPER_FAST
    int "WPM super fast"
    default 90
    
config USE_COMPLETE_CUSTOM_THEME
    bool "Complete custom theme"
    default n

config SPLASH_LOGO_COLOR
    string ""
    default "000000"

config SPLASH_CREATED_BY_COLOR
    string ""
    default "000000"

config SPLASH_BG_COLOR
    string ""
    default "000000"

config SNAKE_DEFAULT_COLOR
    string ""
    default "000000"

config SNAKE_BOARD_COLOR
    string ""
    default "000000"

config SNAKE_BOARD_1_COLOR
    string ""
    default "000000"

config FOOD_COLOR
    string ""
    default "000000"

config SNAKE_COLOR_0
    string ""
    default "000000"

config SNAKE_COLOR_1
    string ""
    default "000000"

config SNAKE_COLOR_2
    string ""
    default "000000"

config SNAKE_COLOR_3
    string ""
    default "000000"

config SNAKE_COLOR_4
    string ""
    default "000000"

config SNAKE_COLOR_5
    string ""
    default "000000"

config SNAKE_COLOR_6
    string ""
    default "000000"

config BATTERY_NUM_COLOR
    string ""
    default "000000"

config BATTERY_PERCENTAGE_COLOR
    string ""
    default "000000"

config BATTERY_BG_COLOR
    string ""
    default "000000"

config BATTERY_NUM_COLOR_1
    string ""
    default "000000"

config BATTERY_PERCENTAGE_COLOR_1
    string ""
    default "000000"

config BATTERY_BG_COLOR_1
    string ""
    default "000000"

config MODIFIER_SELECTED_COLOR
    string ""
    default "000000"

config MODIFIER_UNSELECTED_COLOR
    string ""
    default "000000"

config MODIFIER_BG_COLOR
    string ""
    default "000000"

config SYMBOL_SELECTED_COLOR
    string ""
    default "000000"

config SYMBOL_UNSELECTED_COLOR
    string ""
    default "000000"

config SYMBOL_BG_COLOR
    string ""
    default "000000"

config BT_STATUS_OK_COLOR
    string ""
    default "000000"

config BT_STATUS_NOT_OK_COLOR
    string ""
    default "000000"

config BT_STATUS_OPEN_COLOR
    string ""
    default "000000"

config BT_STATUS_BG_COLOR
    string ""
    default "000000"

config BT_NUM_COLOR
    string ""
    default "000000"

config BT_BG_COLOR
    string ""
    default "000000"

config LAYER_FONT_COLOR
    string ""
    default "000000"

config LAYER_FONT_BG_COLOR
    string ""
    default "000000"

config THEME_FONT_BG_COLOR
    string ""
    default "000000"

config THEME_FONT_COLOR
    string ""
    default "000000"

config THEME_FONT_COLOR_1
    string ""
    default "000000"

config LOGO_FONT_COLOR
    string ""
    default "000000"

config LOGO_SNAKE_COLOR
    string ""
    default "000000"

config LOGO_BG_COLOR
    string ""
    default "000000"

config FRAME_COLOR
    string ""
    default "000000"

config FRAME_COLOR_1
    string ""
    default "000000"

config MENU_BG_COLOR
    string ""
    default "000000"

config WPM_FONT_COLOR
    string ""
    default "000000"

config WPM_FONT_1_COLOR
    string ""
    default "000000"

config WPM_FONT_BG_COLOR
    string ""
    default "000000"



endif
```

## config/boards/shields/st7789_display/Kconfig.shield
```kconfig
# Copyright (c) 2022 Duccio Breschi
# SPDX-License-Identifier: MIT

config SHIELD_ST7789_DISPLAY
    def_bool $(shields_list_contains,st7789_display)

config DISPLAY_BACKLIGHT_BRIGHTNESS
    int "display backlight normal brightness"
    default 80
    range 0 100

config DISPLAY_BACKLIGHT_IDLE_BRIGHTNESS
    int "display backlight idle brightness"
    default 40
    range 0 100
```
